/**
 * @cliArgs --board "/ti/boards/MSP_EXP432P401R" --product "simplelink_msp432p4_sdk@3.40.01.02"
 * @versions {"tool":"1.16.1+2960"}
 */

/**
 * Import the modules used in this configuration.
 */
const PWM  = scripting.addModule("/ti/drivers/PWM", {}, false);
const PWM1 = PWM.addInstance();
const PWM2 = PWM.addInstance();
const PWM3 = PWM.addInstance();
const PWM4 = PWM.addInstance();
const PWM5 = PWM.addInstance();
const RTOS = scripting.addModule("/ti/drivers/RTOS");

/**
 * Write custom configuration values to the imported modules.
 */
PWM1.$name                = "FINGER_1";
PWM1.timer.$assign        = "Timer_A1";
PWM1.timer.pwmPin.$assign = "boosterpack.34";

PWM2.$name                = "FINGER_2";
PWM2.timer.$assign        = "Timer_A1";
PWM2.timer.pwmPin.$assign = "boosterpack.38";

PWM3.$name                = "FINGER_3";
PWM3.timer.pwmPin.$assign = "boosterpack.19";

PWM4.$name                = "FINGER_4";
PWM4.timer.pwmPin.$assign = "boosterpack.39";

PWM5.$name                = "FINGER_5";
PWM5.timer.pwmPin.$assign = "boosterpack.18";

const Power                   = scripting.addModule("/ti/drivers/Power", {}, false);
Power.performanceLevel3.$name = "ti_drivers_power_PowerMSP432PerfLevels0";
Power.performanceLevel2.$name = "ti_drivers_power_PowerMSP432PerfLevels1";
Power.performanceLevel1.$name = "ti_drivers_power_PowerMSP432PerfLevels2";
Power.performanceLevel0.$name = "ti_drivers_power_PowerMSP432PerfLevels3";

RTOS.name = "NoRTOS";

/**
 * Pinmux solution for unlocked pins/peripherals. This ensures that minor changes to the automatic solver in a future
 * version of the tool will not impact the pinmux you originally saw.  These lines can be completely deleted in order to
 * re-solve from scratch.
 */
PWM3.timer.$suggestSolution           = "Timer_A0";
PWM4.timer.$suggestSolution           = "Timer_A1";
PWM5.timer.$suggestSolution           = "Timer_A1";
RTOS.timer0.resource.$suggestSolution = "<error>";
